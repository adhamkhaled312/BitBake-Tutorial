## build/conf/bblayers.conf
```bitbake
BBPATH := "${TOPDIR}"
BBFILES ?= ""
BBLAYERS = " \
  ${TOPDIR}/../meta-tutorial \
  ${TOPDIR}/../meta-two \
  ${TOPDIR}/../meta-hmm \
"
	    
```

## meta-tutorial/conf/layer.conf
```bitbake
BBPATH .= ":${LAYERDIR}"
BBFILES += "${LAYERDIR}/recipes-*/*/*.bb"
BBFILE_COLLECTIONS += "tutorial"
# and use name as suffix for other properties
BBFILE_PATTERN_tutorial = "^${LAYERDIR}/"
BBFILE_PRIORITY_tutorial = "5"
LAYERSERIES_CORENAMES = "bitbaketutorial"

LAYERVERSION_tutorial = "1"
LAYERSERIES_COMPAT_tutorial = "bitbaketutorial"
```
